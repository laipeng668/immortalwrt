#include <dt-bindings/thermal/thermal.h>
#include "ipq6018-cpr-regulator.dtsi"

&CPU0 {
	cpu-supply = <&apc_vreg>;
};

&CPU1 {
	cpu-supply = <&apc_vreg>;
};

&CPU2 {
	cpu-supply = <&apc_vreg>;
};

&CPU3 {
	cpu-supply = <&apc_vreg>;
};
